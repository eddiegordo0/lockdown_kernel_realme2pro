## drivers/soc/oppo/Kconfig
```kconfig
# ifdef CONFIG_PRODUCT_REALME_RMX1801 
# yixue.ge add for config oppo software common soft
config OPPO_ARCH_FILE
	bool "for build directory oppo"
	---help---
	say Y to buid in

config OPPO_COMMON_SOFT
      bool "config oppo common software"
	  select OPPO_ARCH_FILE
	  help
		define this config to get project verion from sharemem.
		Maybe this value is from CDT or dynamic identify by hardware
		id.

config OPPO_DEVICE_IFNO
      bool "config oppo devinfo"
	  select OPPO_ARCH_FILE
	  help
		define this config to compile devinfo.c for device register
		.
source "drivers/soc/oppo/oppo_project/Kconfig"

source "drivers/soc/oppo/oppo_devinfo/Kconfig"

#ifdef CONFIG_PRODUCT_REALME_RMX1801
#//jie.cheng@swdp.sh, 2016/04/15, Add hypnus helper
source "drivers/soc/oppo/oppo_hypnus/Kconfig"
#endif /* CONFIG_PRODUCT_REALME_RMX1801 */

#ifdef CONFIG_PRODUCT_REALME_RMX1801
#//wenbin.liu@PSW.Kernel.MM, 2018/05/23, Add for Healthinfo monitor
source "drivers/soc/oppo/oppo_healthinfo/Kconfig"
#endif /* CONFIG_PRODUCT_REALME_RMX1801 */
```
